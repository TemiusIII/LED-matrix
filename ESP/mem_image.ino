#include <avr/pgmspace.h>  // Needed to store stuff in Flash using PROGMEM
#include "FastLED.h"       // Fastled library to control the LEDs

// How many leds are connected?
#define NUM_LEDS 1024
#define DATA_PIN 12
#define BRIGHTNESS 10


CRGB leds[NUM_LEDS];


const long Image0[] PROGMEM =
{
0x990030, 0x990030, 0x990030, 0x990030, 0x990030, 0x990030, 0x990030, 0x990030, 0xffc20e, 0xffc20e, 0xffc20e, 0xffc20e,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 0x990030
};
const long Image1[] PROGMEM =
{
0x990000, 0x990000, 0x990000, 0x990030, 0x990030, 0x990030, 0x990030, 0x990030, 0xffc20e, 0xffc20e, 0xffc20e, 0xffc20e,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 0x990030
};
void drawImage(int del){
FastLED.clear();
for(int i = 0; i < NUM_LEDS; i++) {
    leds[i] = pgm_read_dword(&(Image0[i]));  // Read array from Flash
  }
FastLED.show();
delay(del);

FastLED.clear();
for(int i = 0; i < NUM_LEDS; i++) {
    leds[i] = pgm_read_dword(&(Image1[i]));  // Read array from Flash
  }
FastLED.show();
delay(del);


}

void rainbow(int wait = 10, int BRIGHTNESS = 255 , int SATURATION = 255) {
  for (int j = 0; j < 255; j++) {
    for (int i = 0; i < NUM_LEDS; i++) {
      leds[i] = CHSV(i - (j * 2), SATURATION, BRIGHTNESS);
    }
    FastLED.show();
    delay(wait);
  }
}
long color = 0xFF00FF;
void fill_color(){
      for (int i = 0; i < NUM_LEDS; i++){
      leds[i] = color;
      FastLED.show();
      delay(30);
    }
      
}

void clear(){
      for (int i = 0; i < NUM_LEDS; i++){
      leds[i] = 0x000000;
      }
    FastLED.show();
}



void setup() { 
FastLED.addLeds<NEOPIXEL,DATA_PIN>(leds, NUM_LEDS);
FastLED.setBrightness(BRIGHTNESS);
Serial.begin(9600);
Serial.println("Started");
clear();
}

void loop() { 
// clear();
// fill_color();
// clear();
drawImage(700);

}